## kernel/drivers/Kconfig
```kconfig
# SPDX-License-Identifier: GPL-2.0
menu "Device Drivers"

# Keep I/O buses first

source "drivers/amba/Kconfig"
source "drivers/pci/Kconfig"


source "drivers/base/Kconfig"

source "drivers/bus/Kconfig"

source "drivers/connector/Kconfig"



source "drivers/of/Kconfig"


source "drivers/pnp/Kconfig"

source "drivers/block/Kconfig"

source "drivers/nvme/Kconfig"



source "drivers/scsi/Kconfig"

source "drivers/ata/Kconfig"

source "drivers/md/Kconfig"





source "drivers/net/Kconfig"



# input before char - char/joystick depends on it. As does USB.

source "drivers/input/Kconfig"

source "drivers/char/Kconfig"

source "drivers/i2c/Kconfig"


source "drivers/spi/Kconfig"



source "drivers/pps/Kconfig"

source "drivers/ptp/Kconfig"

source "drivers/pinctrl/Kconfig"

source "drivers/gpio/Kconfig"


source "drivers/power/Kconfig"

source "drivers/hwmon/Kconfig"

source "drivers/thermal/Kconfig"

source "drivers/watchdog/Kconfig"



source "drivers/mfd/Kconfig"

source "drivers/regulator/Kconfig"


source "drivers/video/Kconfig"

source "sound/Kconfig"

source "drivers/hid/Kconfig"

source "drivers/usb/Kconfig"



source "drivers/leds/Kconfig"




source "drivers/rtc/Kconfig"

source "drivers/dma/Kconfig"

source "drivers/dma-buf/Kconfig"







source "drivers/virtio/Kconfig"







source "drivers/platform/Kconfig"

source "drivers/clk/Kconfig"


source "drivers/clocksource/Kconfig"

source "drivers/mailbox/Kconfig"

source "drivers/iommu/Kconfig"




source "drivers/soc/Kconfig"







source "drivers/pwm/Kconfig"

source "drivers/irqchip/Kconfig"


source "drivers/reset/Kconfig"

source "drivers/phy/Kconfig"

source "drivers/powercap/Kconfig"



source "drivers/ras/Kconfig"




source "drivers/gpu/trace/Kconfig"



source "drivers/nvmem/Kconfig"

















endmenu
```
